## examples/test-esp32-simple-iot-framework/src/Kconfig.projbuild
```kconfig
menu "ESP32 Simple IOT Framework Test"

    choice
        prompt "Log Level"
        default IOT_LOG_ERROR
        help
            Max log level used by the exerciser to report various log 
            information on the USB port.
        config IOT_LOG_NONE
            bool "None"
        config IOT_LOG_ERROR
            bool "Error"
        config IOT_LOG_WARN
            bool "Warning"
        config IOT_LOG_INFO
            bool "Info"
        config IOT_LOG_DEBUG
            bool "Debug"
        config IOT_LOG_VERBOSE
            bool "Verbose"
    endchoice
    
    config IOT_TOPIC_NAME
        string "MQTT Topic Name"
        default "topic_name"
        help
            Enter the topic name that will be used by the gateway to
            generate the complete topic name to be sent to the MQTT broker.
    
    config IOT_BATTERY_LEVEL
        bool "Enable battery voltage level retrieval"
        default "n"
        help
            If enabled, the battery voltage level will be retrieved using the
            Battery class. The code may require some adjustments depending on
            the electronics.
            
    config IOT_WATCHDOG_INTERVAL
        int "Interval (in seconds) between Watchdog packet transmission."
        default 86400
        range 60 864000
        help
            The IoT framework is sending a Watchdog packet at the specified
            interval to signify that the device is still alive. 86400 seconds 
            is one day.
    choice
        prompt "Transmission Protocol"
        default IOT_ENABLE_ESP_NOW
        help
            Select the protocol to be used to transmit packets to
            the ESP32 Gateway.
        config IOT_ENABLE_UDP
            bool "UDP"
        config IOT_ENABLE_ESP_NOW
            bool "ESP-NOW"
    endchoice

    menu "UDP Protocol"
        depends on IOT_ENABLE_UDP
        config IOT_UDP_PORT
            int "UDP Port"
            default 3333
            range 0 65535
            help
                The UDP Port to be used the exerciser to transmit packets to the
                gateway.

        config IOT_UDP_MAX_PKT_SIZE
            int "UDP Max Packet Size"
            default 250
            range 2 1450
            help
                The UDP maximum packet size allowed. The first 2 bytes are
                reseved for the CRC checksum.

        config IOT_GATEWAY_ADDRESS
            string "Gateway Address"
            default "0.0.0.0"
            help
                Enter the Gateway address. It can be entered as a standard IPv4
                dotted decimal notation (xx.xx.xx.xx) or as a DNS name.
    endmenu

    menu "ESP-NOW Protocol"
        config IOT_ESPNOW_PMK
            string "ESP-NOW primary master key"
            default "pmk1234567890123"
            help
                ESP-NOW Primary Master Key (PMK) for the exerciser and gateway
                to use. The length of the key must be 16 characters. 
                Please ensure that the key is in synch with the PMK defined in the
                gateway.

        config IOT_APSSID_PREFIX
            string "Gateway AP SSID Prefix"
            default "RX"
            help
                Enter the beginning of the SSID for the gateway Access Point (AP).
                This will be used to find the AP MAC adress to transmit ESP-NOW 
                packets to the gateway.

        config IOT_ENCRYPT
            bool "Encryption enabled"
            default "n"
            help
                Set if this device is using packet encryption. If set, the gateway
                internal table of encrypted devices must be modified accordingly.

        config IOT_ESPNOW_LMK
            depends on IOT_ENCRYPT
            string "ESP-NOW local master key"
            default "lmk1234567890123"
            help
                ESP-NOW local master key (LMK) for the exerciser
                to use. The length of LMK must be 16 characters.
                Please ensure that the key reflects the gateway configuration.

        config IOT_CHANNEL
            int "Channel"
            default 1
            range 0 14
            help
                The channel to be used by the gateway. Note that it must be
                the same as defined in the WiFi router. Usual values are 1,
                6, or 11. These preferred values are to diminish potential r/f
                interference.

        config IOT_ESPNOW_MAX_PKT_SIZE
            int "ESP-NOW Max Packet Size"
            default 248
            range 10 248
            help
                The ESP-NOW maximum packet size allowed without considering the CRC.
                 Cannot be larger than 248.

        config IOT_ESPNOW_ENABLE_LONG_RANGE
            bool "Enable Long Range"
            default "n"
            help
                When enable long range, the PHY rate of ESP32 will be 512Kbps
                or 256Kbps
    endmenu

    menu "Wifi"
        config IOT_WIFI_ESP_NOW_STA_SSID
            depends on IOT_ENABLE_ESP_NOW
            string "Wifi Gateway SSID"
            default "your_wifi_gateway_ssid"
            help
                SSID associated with Wifi as defined in your gateway. Will be used 
                to find the gateway MAC address when unknown. 

        config IOT_WIFI_ESP_NOW_STA_PASS
            depends on IOT_ENABLE_ESP_NOW
            string "Wifi Gateway Password"
            default "your_wifi_gateway_password"
            help
                Password associated with Wifi as defined in your gateway.
                Can be empty.

        config IOT_WIFI_UDP_STA_SSID
            depends on IOT_ENABLE_UDP
            string "Wifi Router SSID"
            default "your_wifi_router_ssid"
            help
                Wifi SSID as defined in your router.

        config IOT_WIFI_UDP_STA_PASS
            depends on IOT_ENABLE_UDP
            string "Wifi Router Password"
            default "your_wifi_router_password"
            help
                Wifi Password as defined in your router.
                Can be empty.

        choice
            prompt "Wifi Gateway Authorization Mode"
            default IOT_WIFI_STA_WPA2
            help
                Authorization mode as defined in your gateway.
            config IOT_WIFI_STA_WPA3
                bool "WPA3"
            config IOT_WIFI_STA_WPA2
                bool "WPA2"
            config IOT_WIFI_STA_WPA
                bool "WPA"
            config IOT_WIFI_STA_WEP
                bool "WEP"
        endchoice
    endmenu
endmenu
```
